#include "geometry.hpp"

namespace cuby {
bool earth;
uint8_t cubyX, cubyY;
const uint8_t LEVEL_WIDTH = 8, LEVEL_HEIGHT = 8, LEVEL_COUNT = 5;
const uint8_t LEVEL_CHARS[LEVEL_COUNT][2] = {{1, 1}, {1, 1}, {1, 1}, {1, 1}, {6, 6}};
const uint8_t PROGMEM bricks[] = {
  0xe8, 0xe4, 0xe8, 0xe4, 0xe8, 0xe4, 0xa0, 0x62, 0x00, 0x00, 0xe8, 0xe4,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 0x00,
};

const uint8_t PROGMEM flag[] = {
  0x00, 0x00, 0x00, 0x00, 0x00, 0x00, 0x00, 0x00, 0x00, 0x00, 0x00, 0x00,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 0x00,
};

const uint8_t PROGMEM cuby[] = {
  0xff, 0x80, 0xff, 0x80, 0xff, 0x80, 0xff, 0x80, 0xff, 0x80, 0xff, 0x80,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 0x80,
};

const uint8_t PROGMEM earthImage[] = {
  0xf8, 0x1f, 0xf8, 0x1f, 0xf8, 0x1f, 0x00, 0x00, 0xf8, 0x1f, 0xf8, 0x1f,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 0x1f,
};

const char PROGMEM LEVELS[LEVEL_COUNT][LEVEL_HEIGHT][LEVEL_WIDTH + 1] = {
  {
    "########",
    "# #.#  #",
    "#   #  #",
    "# ### ##",
    "#  #   #",
    "#  #   #",
    "#     !#",
    "########"
  },
  {
    "########",
    "#  #  !#",
    "#  #   #",
    "#      #",
    "#  #   #",
    "#  #   #",
    "#      #",
    "########"
  },
  {
    "########",
    "#    # #",
    "#!     #",
    "#   #  #",
    "##     #",
    "#     ##",
    "#  #   #",
    "########"
  },
  {
    "########",
    "#  #   #",
    "#!     #",
    "#      #",
    "#      #",
    "#   ####",
    "# #    #",
    "########"
  },
  {
    "########",
    "#  #!!!#",
    "#      #",
    "#      #",
    "#      #",
    "#   ####",
    "#e#    #",
    "########"
  }
};

void drawLevel(uint8_t index) {
  for (uint8_t x = 0; x < LEVEL_WIDTH; x++) {
    for (uint8_t y = 0; y < LEVEL_HEIGHT; y++) {
      switch (pgm_read_byte(&LEVELS[index][y][x])) {
        case '#':
          oled::fastDrawImage(x * 16, y * 16, 16, 16, bricks);
          break;
        case '.':
          oled::fillRect(x * 16, y * 16, 16, 16, 0x0002);
          oled::setCursor(x * 16, y * 16);
          oled::print("GD");
          break;
        case 'e':
          if (!earth) oled::drawImage(x * 16, y * 16, 16, 16, earthImage, MAGENTA);
          break;
        case '!':
          oled::fastDrawImage(x * 16, y * 16, 16, 16, flag);
          break;
      }
    }
  }
}

void run() {
  for (uint8_t i = 0; i < LEVEL_COUNT; i++) {
    cubyX = LEVEL_CHARS[i][0];
    cubyY = LEVEL_CHARS[i][1];
    while (true) {
      updateController();
      if (buttonY.bReleased) {
        return;
      }
      drawFrame();
      uint8_t oldCubyX = cubyX, oldCubyY = cubyY;
      if (joyX != 0 || joyY != 0) {
        while (pgm_read_byte(&LEVELS[i][cubyY + joyY][cubyX + joyX]) != '#') {
          cubyX += joyX;
          cubyY += joyY;
        }
      }
      oled::clear();
      drawLevel(i);
      oled::fastDrawImage(cubyX * 16 + 4, cubyY * 16 + 4, 8, 8, cuby);
      drawFrame();
      if (pgm_read_byte(&LEVELS[i][cubyY][cubyX]) == '!') {
        break;
      } else if (pgm_read_byte(&LEVELS[i][cubyY][cubyX]) == '.') {
        oled::fillScreen(BLACK);
        oled::drawRect(cubyX * 16, cubyY * 16, geometry::PLAYER_SIZE, geometry::PLAYER_SIZE, BLUE);
        for (int i = 0; i <= oled::height - cubyY * 16 - 16; i += 3) {
          oled::update(max(cubyX * 16 - i, 0), max(cubyY * 16 - i, 0),
                       min(16 + i * 2, int(oled::width)), min(16 + i * 2, int(oled::height)));
          yield();
        }
        geometry::run(cubyX * 16, cubyY * 16);
        return;
      } else if (pgm_read_byte(&LEVELS[i][cubyY][cubyX]) == 'e') {
        oled::fillRect(cubyX * 16, cubyY * 16, 16, 16, BLACK);
        oled::fastDrawImage(cubyX * 16 + 4, cubyY * 16 + 4, 8, 8, cuby);
        oled::update(cubyX * 16, cubyY * 16, 16, 16);
        earth = true;
        saveProfile();
      }
    }
  }
  gui::centerText("You win!");
  drawFrame();
  delay(5000);
}
}
